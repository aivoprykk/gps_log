## Kconfig
```kconfig
menu "Logger GPS Log Module Configuration"
    config GPS_LOG_ENABLED
        bool "Enable GPS Log Module"
        default n if !UBLOX_ENABLED
        default y
        help
        Enable GPS Log Module
    if GPS_LOG_ENABLED
    config GPS_BUFFER_SIZE
        int "GPS Module Buffer Size (num)"
        default 5128
        help
            Desired buffer size for GPS groundspeed data, be careful for 10Hz or 20Hz the buffer needs to be much larger !!! 
            Eg. 1852m with 2000 samples is min 10m/s * 3.6 = 36 km/h, 1852m is 185s, 185s * 10Hz = 1850 samples, 185s * 20Hz = 3700 samples
            Eg. 1852m with 1000 samples is min 20m/s * 3.6 = 72 km/h, 1852m is 92s, 92s * 10Hz = 920 samples, 92s * 20Hz = 1840 samples
            Eg. 1852m with 740 samples is min 25m/s * 3.6 = 90 km/h, 1852m is 74s, 74s * 10Hz = 740 samples, 74s * 20Hz = 1480 samples
            Reduce buffer size from 5000 to 1000, so that at 2Hz and 600s there is still a 1-second interval,
            at 10 Hz this is 200 s, so the lowest speed is then 500m/200s, which is 2.5m/s or < 10 km/h
    config GPS_ALFA_BUFFER_SIZE
        int "GPS Module Alfa Buffer Size (num)"
        default 2000
        help
            Desired buffer size for alpha speed calculation, it should only accommodate 500m distance !!10
    config GPS_NAV_SAT_BUFFER_SIZE
        int "GPS Module Nav Sat Buffer Size (num)"
        default 10
        help
            GPS_SAT_info buffersize for Mean CNO  values, here 10 NAV_SAT messages are stored
    config GPS_LOG_STACK_SIZE
        int "GPS Log Module Stack Size in bytes"
        default 3072
        help
        GPS Log Module Stack Size in bytes
    config GPS_LOG_ENABLE_GPY
        bool "Enable GPY Log Message Format"
        default n
        help
        Enable GPY Log Message Format
    config GPS_SPEED_ERROR_LOGGING
        bool "Enable GPS Speed Metrics Error Logging to TXT files"
        default n
        help
            Enable comprehensive error logging for GPS speed metrics initialization 
            and memory allocation failures. Errors will be written to .txt log files 
            for persistent debugging. Disable to reduce program size and memory usage.
    choice
        bool "Default log verbosity"
        default GPS_LOG_LEVEL_ERROR
        help
            Specify how important log should be added.
        config GPS_LOG_LEVEL_TRACE
            bool "TRACE: A lot of logs to give detailed information"
        config GPS_LOG_LEVEL_INFO
            bool "INFO: Log important events"
        config GPS_LOG_LEVEL_WARN
            bool "WARN: Log if something unwanted happened but didn't cause a problem"
        config GPS_LOG_LEVEL_ERROR
            bool "ERROR: Only critical issues, when the system may fail"
        config GPS_LOG_LEVEL_USER
            bool "USER: Only logs added by the user"
        config GPS_LOG_LEVEL_NONE
            bool "NONE: Do not log anything"
    endchoice
    config GPS_LOG_LEVEL
        int
        default 0 if GPS_LOG_LEVEL_TRACE
        default 1 if GPS_LOG_LEVEL_INFO
        default 2 if GPS_LOG_LEVEL_WARN
        default 3 if GPS_LOG_LEVEL_ERROR
        default 4 if GPS_LOG_LEVEL_USER
        default 5 if GPS_LOG_LEVEL_NONE
    endif
    choice
        bool "Json library"
        default GPS_LOG_USE_CCAN_JSON
        config GPS_LOG_USE_CJSON
            bool "Enable CJSON for GPS Log Module"
            help
                Enable CJSON for GPS Log Module
        config GPS_LOG_USE_CCAN_JSON
            bool "Enable CCAN Json for GPS Log Module"
            help
                Enable CCAN Json for GPS Log Module       
    endchoice
endmenu
```

## examples/gps_log_test/sdkconfig.defaults
```kconfig
# GPS Log Test Example - sdkconfig defaults

# Enable GPS log component
CONFIG_GPS_LOG_ENABLED=y
CONFIG_GPS_LOG_STACK_SIZE=8192
CONFIG_LOGGER_VFS_ENABLED=y
CONFIG_LOGGER_UBX_ENABLED=y
CONFIG_GPS_LOG_LEVEL_INFO=y

# Use static buffers for GPS (avoid dynamic allocation issues)
CONFIG_GPS_LOG_STATIC_A_BUFFER=y
CONFIG_GPS_LOG_STATIC_S_BUFFER=y

# Enable ESP32 Task Watchdog
CONFIG_ESP_TASK_WDT=y
CONFIG_ESP_TASK_WDT_TIMEOUT_S=10
CONFIG_ESP_TASK_WDT_CHECK_IDLE_TASK_CPU0=y
CONFIG_ESP_TASK_WDT_CHECK_IDLE_TASK_CPU1=y

# Increase main task stack size
CONFIG_ESP_MAIN_TASK_STACK_SIZE=8192

# FreeRTOS configuration
CONFIG_FREERTOS_HZ=1000
CONFIG_FREERTOS_WATCHPOINT_END_OF_STACK=y

# ESP Event Loop
CONFIG_ESP_EVENT_LOOP_STACK_SIZE=4096

# Logging
CONFIG_LOG_DEFAULT_LEVEL_INFO=y
CONFIG_LOG_MAXIMUM_LEVEL_DEBUG=y

# UART configuration (not used but component requires it)
CONFIG_LOGGER_UBX_UART_NUM=1
CONFIG_LOGGER_UBX_UART_BAUD_RATE=115200
CONFIG_LOGGER_UBX_UART_RXD_PIN=16
CONFIG_LOGGER_UBX_UART_TXD_PIN=17

# Disable components we don't need for testing
CONFIG_LOGGER_WIFI_ENABLED=n
CONFIG_LOGGER_HTTP_ENABLED=n
CONFIG_DISPLAY_ENABLED=n
CONFIG_LOGGER_ADC_ENABLED=n
CONFIG_LOGGER_BUTTON_ENABLED=n
```
